## conf/layer.conf
```bitbake
#LAYERDEPENDS_meta-nano = "meta-freescale"

LAYERSERIES_COMPAT_meta-nano = "rocko sumo thud zeus dunfell kirkstone"

# We have a conf and classes directory, add to BBPATH
BBPATH := "${LAYERDIR}:${BBPATH}"

# We have recipes-* directories, add to BBFILES
BBFILES := "${BBFILES} ${LAYERDIR}/recipes-*/*/*.bb \
	${LAYERDIR}/recipes-*/*/*.bbappend"

BBFILE_COLLECTIONS += "meta-nano"
BBFILE_PATTERN_meta-nano := "^${LAYERDIR}/"
BBFILE_PRIORITY_meta-nano = "10"
```

## conf/machine/ls1012anano.conf
```bitbake
#@TYPE: Machine
#@NAME: INCOstartec NanoFW board
#@SOC: LSCH2
#@DESCRIPTION: Machine configuration for NanoFW board
#              with NXP LS1012A ARM Cortext-A53 core

MACHINEOVERRIDES =. "fsl-lsch2:ls1012a:"

require conf/machine/include/qoriq-arm64.inc
require conf/machine/include/arm/arch-arm64.inc

MACHINE_FEATURES += "optee"

KERNEL_CLASSES  = " kernel-fitimage "
KERNEL_IMAGETYPES = "fitImage"

UBOOT_DTB_LOADADDRESS = "0x90000000"
UBOOT_ENTRYPOINT = "0x80080000"

UBOOT_CONFIG ??= "qspi"
UBOOT_CONFIG[qspi] = "ls1012anano_qspi_defconfig,,u-boot-dtb.bin"
# TODO
# UBOOT_CONFIG[tfa] = "ls1012anano_tfa_defconfig"
# UBOOT_CONFIG[tfa-secure-boot] = "ls1012anano_tfa_SECURE_BOOT_defconfig"

KERNEL_DEVICETREE ?= "freescale/fsl-ls1012a-nano.dtb"
KERNEL_DEFCONFIG ?= "defconfig"

EXTRA_IMAGEDEPENDS += "ppfe-firmware rcw"
USE_VT = "0"

ACCEPT_FSL_EULA = "1"

PREFERRED_PROVIDER_virtual/kernel = "linux-qoriq"
```
